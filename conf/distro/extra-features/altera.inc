## conf/distro/extra-features/altera.inc
```bitbake
# Prefer building u-boot-socfpga v2019.01 recipe, as v2017.09 recipe
# does not compile with dtc v1.4.7 (present in thud).
PREFERRED_VERSION_u-boot-socfpga_stratix10 ?= "v2019.01"

# The u-boot-socfpga v2019.01 generated u-boot-spl.bin and
# u-boot.img, instead of u-boot-spl-dtb.bin and u-boot-dtb.img;
# hence change SPL_BINARY and UBOOT_BINARY accordingly.

SPL_BINARY_stratix10 = "spl/u-boot-spl.bin"
UBOOT_BINARY_stratix10 = "u-boot.img"

IMAGE_BOOT_FILES_remove_stratix10 = "u-boot-dtb.${UBOOT_SUFFIX}"
IMAGE_BOOT_FILES_append_stratix10 = " u-boot.${UBOOT_SUFFIX} "
```

## conf/distro/extra-features/base-feature.conf
```bitbake
# LTTng feature
KERNEL_CFG_FILES += "${@bb.utils.contains('IMAGE_FEATURES', 'lttng', 'lttng.cfg', '', d)}"
FEATURE_PACKAGES_lttng = " lttng2-ust lttng-modules lttng-tools babeltrace "
#FIXME lttng-modules does not build against 4.14
FEATURE_PACKAGES_lttng = " lttng2-ust  lttng-tools babeltrace "

# Fumount feature 
KERNEL_CFG_FILES += "${@bb.utils.contains('IMAGE_FEATURES', 'fumount', 'fumount.cfg', '', d)}"
FEATURE_PACKAGES_fumount = ""

# Livedump feature
KERNEL_CFG_FILES += "${@bb.utils.contains('IMAGE_FEATURES', 'livedump', 'livedump.cfg', '', d)}"
FEATURE_PACKAGES_livedump = " pcoredump pcoredump-dev gdb gdb-dev "

# MicrState Accounting feature
KERNEL_CFG_FILES += "${@bb.utils.contains('IMAGE_FEATURES', 'msa', 'msa.cfg', '', d)}"
FEATURE_PACKAGES_msa = ""

# GDB feature
FEATURE_PACKAGES_gdb = " gdb gdbserver"

# Perf feature
KERNEL_CFG_FILES += "${@bb.utils.contains('IMAGE_FEATURES', 'perf', 'perf.cfg', '', d)}"
FEATURE_PACKAGES_perf = " perf "

# Valgrind feature
FEATURE_PACKAGES_valgrind = " ${VALGRIND} "

# KGDBOC feature
KERNEL_CFG_FILES += "${@bb.utils.contains('IMAGE_FEATURES', 'kgdboc', 'kgdboc.cfg', '', d)}"
FEATURE_PACKAGES_kgdboc = ""
```

## conf/distro/extra-features/freescale.inc
```bitbake
PREFERRED_PROVIDER_u-boot-mkimage-native = "u-boot-tools-native"
PREFERRED_PROVIDER_nativesdk-u-boot-mkimage = "nativesdk-u-boot-tools"
PREFERRED_PROVIDER_openssl ?= "openssl-qoriq"
PREFERRED_PROVIDER_qemu = "qemu-qoriq"

QEMU_TARGETS_mx8 ?= "arm aarch64 i386 mips mipsel mips64 mips64el ppc sh4 x86_64"
PREFERRED_PROVIDER_virtual/kernel_mx8 ?= 'linux-imx'
DISTRO_FEATURES_append_mx8 += 'wayland'
PREFERRED_PROVIDER_cryptodev-linux_mx8 ?= 'cryptodev-qoriq-linux'

addhandler fsl_eula_check
fsl_eula_check[eventmask] = "bb.event.SanityCheck"
python fsl_eula_check() {
    if e.data.getVar('ACCEPT_FSL_EULA') != "1":
        eula_file = d.getVar('FSL_EULA_FILE', True)
        bb.warn("Not setting ACCEPT_FSL_EULA = '1' could cause some \
build failures in bootloader, graphics related recipes or graphics applications \
may not work well. So it is advised to read Freescale EULA at '%s' and accept \
it by setting ACCEPT_FSL_EULA = '1' in conf/local.conf for Freescale Products." % eula_file)
}
```

## conf/distro/extra-features/riscv.inc
```bitbake
PREFERRED_PROVIDER_u-boot-mkimage-native = "u-boot-tools-native"
PREFERRED_PROVIDER_nativesdk-u-boot-mkimage = "nativesdk-u-boot-tools"
```

## conf/distro/extra-features/select-features.inc
```bitbake
include base-feature.conf

# Display available Kernel fragment IMAGE_FEATURES 
def getAvailableImageFeatures(d):
    valid_features = []
    for var in d:
       if var.startswith("FEATURE_PACKAGES_"):
           valid_features.append(var[17:])
    return ' '.join(valid_features)

KERNEL_IMAGE_FEATURES = "${@getAvailableImageFeatures(d)}"
```

## conf/distro/include/common-image.inc
```bitbake
FEATURE_PACKAGES_tools-devrocket = "${FEATURE_PACKAGES_tools-debug} ${FEATURE_PACKAGES_eclipse-debug} ${FEATURE_PACKAGES_tools-profile} packagegroup-devrocket"
FEATURE_PACKAGES_mvl = "distro-version mvl-support"
BBCLASSEXTEND:pn-xz = "native nativesdk"
BBCLASSEXTEND:pn-xz-nativesdk = "native nativesdk"
BBCLASSEXTEND:pn-acl = "native nativesdk"
BBCLASSEXTEND:pn-acl-nativesdk = "native nativesdk"
BBCLASSEXTEND:pn-attr = "native nativesdk"
BBCLASSEXTEND:pn-attr-nativesdk = "native nativesdk"


#From meta-measured, make sure BB_NO_NETWORK continues to work.
SRCREV:pn-pcr-calc = "250141b0cc42e87e83f510fd6a36f68b7b58fe1c"
SRCREV:pn-pcr-calc-native = "250141b0cc42e87e83f510fd6a36f68b7b58fe1c"
SRCREV:pn-pyelftools = "546e692243895888cb2a6201b3bc263fd2cbc1ad"
SRCREV:pn-pyelftools-native = "546e692243895888cb2a6201b3bc263fd2cbc1ad"
LIC_FILES_CHKSUM:pn-pyelftools = "file://LICENSE;md5=5ce2a2b07fca326bc7c146d10105ccfc"
LIC_FILES_CHKSUM:pn-pyelftools-native = "file://LICENSE;md5=5ce2a2b07fca326bc7c146d10105ccfc"

RDEPENDS:packagegroup-tpm:remove = "kernel-module-tpm-nsc"
RDEPENDS:packagegroup-tpm:remove = "kernel-module-tpm-atmel"
RDEPENDS:packagegroup-tpm:remove = "kernel-module-tpm-infineon"

# Meta measured bbappend breaks strongswan package config
MEASURED_STRONGSWAN = " \
    aikgen \
    imc-test \
    imv-test \
    imc-scanner \
    imv-scanner \
    imc-os \
    imv-os \
    imc-attestation \
    imv-attestation \
    imc-swid \
    tnc-ifmap \
    tnc-imc \
    tnc-imv \
    tnc-pdp \
    tnccs-11 \
    tnccs-20 \
    tnccs-dynamic \
    tss-trousers \
"
PACKAGECONFIG:pn-strongswan = "charon curl gmp openssl stroke sqlite3 \
                               ${@bb.utils.contains('DISTRO_FEATURES', 'systemd', 'systemd-charon', '', d)} \
                               ${@bb.utils.contains('DISTRO_FEATURES', 'ldap', 'ldap', '', d)} \
                               ${@bb.utils.contains("BBFILE_COLLECTIONS", "measured", "${MEASURED_STRONGSWAN}", "", d)} \
"

PACKAGECONFIG:append:pn-gdb = " python "

CFLAGS:pn-cacao-initial-native:append = " -fno-strict-aliasing "
CFLAGS:pn-efivar-native:append = " -fno-strict-aliasing "

PREFERRED_VERSION_python-sqlalchemy = "1.0.8"
PREFERRED_VERSION_python-greenlet = "0.4.9"

PREFERRED_RPROVIDER_lib32-initd-functions = "lib32-initscripts"
PREFERRED_RPROVIDER_lib64-initd-functions = "lib64-initscripts"
OS_DEFAULT_INITSCRIPT_PARAMS ??= "defaults 30 10"

PREFERRED_RPROVIDER_u-boot-mkimage ?= "u-boot-mkimage"
PREFERRED_RPROVIDER_lib32-u-boot-mkimage ?= "lib32-u-boot-mkimage"
PREFERRED_RPROVIDER_lib64-u-boot-mkimage ?= "lib64-u-boot-mkimage"

# Get rid of older bbappend files
BBMASK += "meta-openstack/recipes-connectivity/openssh/openssh_6.%.bbappend"
BBMASK += "meta-openstack/recipes-support/iproute2/iproute2_3.%.bbappend"
BBMASK += "meta-openstack/recipes-support/fuse/fuse_2.9.3.bbappend"
BBMASK += "meta-openstack/recipes-extended/iscsi-initiator-utils/"
BBMASK += "meta-openstack/recipes-support/postgresql/"
BBMASK += "meta-cgl-common/recipes-cgl/makedumpfile/makedumpfile_1.5.8.bb"
BBMASK += "meta-virtualization/recipes-devtools/python/python3-twisted_13.2.0.bb"

LLVMVERSION = "13.0.1"
```

## conf/distro/include/layer-includes.inc
```bitbake
#Fix ups for including freescale, riscv, altera.
include ${@bb.utils.contains("BBFILE_COLLECTIONS", "freescale-layer", "conf/distro/extra-features/freescale.inc", "", d)}
include ${@bb.utils.contains("BBFILE_COLLECTIONS", "riscv-layer", "conf/distro/extra-features/riscv.inc", "", d)}
include ${@bb.utils.contains("BBFILE_COLLECTIONS", "meta-altera", "conf/distro/extra-features/altera.inc", "", d)}
```

## conf/distro/include/meta-lmp-base.inc
```bitbake
USE_SYSTEMD = "1"
DISTRO_FEATURES:append = " systemd "
DISTRO_FEATURES:remove = "sysvinit"
VIRTUAL-RUNTIME_init_manager = "systemd"
VIRTUAL-RUNTIME_initscripts = "systemd-compat-units"

SAVE_DISTRO := "${DISTRO}"
SAVE_DISTRO_NAME := "${DISTRO_NAME}"
include conf/distro/lmp.conf
DISTRO := "${SAVE_DISTRO}"
DISTRO_NAME := "${SAVE_DISTRO_NAME}"
OVERRIDES:append = ":lmp"

IMAGE_BOOT_FILES_rpi:prepend = "bootfiles/* "

ERROR_QA:remove = "installed-vs-shipped"

PR:pn-mvl-support = "3.4.0"
```

## conf/distro/include/multilib-doc.inc
```bitbake
# Deal with multilib doc conflicts.

mandir:pn-sudo = "${datadir}/man/${PN}"
mandir:pn-rxvt-unicode = "${datadir}/man/${PN}"
mandir:pn-freeradius = "${datadir}/man/${PN}"
mandir:pn-dhcpcd = "${datadir}/man/${PN}"
mandir:pn-xserver-xorg = "${datadir}/man/${PN}"
docdir:pn-samhain-standalone = "${datadir}/doc/${PN}"
```

## conf/distro/include/mvl-blacklist.inc
```bitbake
PN_MESSAGE="IS NOT supported in mvl beacause "

#PNBLACKLIST_pn-foo = "${PN_MESSAGE} it requires software not provided in layer set"
```

## conf/distro/include/mvl-skiplist.inc
```bitbake
PN_MESSAGE="IS NOT supported in mvl beacause "

#SKIP_RECIPE[foo] = "${PN_MESSAGE} it requires software not provided in layer set"
```

## conf/distro/include/tcmode-external-mvl.inc
```bitbake
#
# Configuration to use external MVL toolchain
#
# MontaVista Version of CS external toolchain mode.
#
#

#Disable task for a until its cleaned up.
TOOLCHAIN_HOST_TASK="nativesdk-packagegroup-sdk-host meta-environment-${MACHINE}"
MVL_TOOLS_TOPLEVEL_PREFIX ?='${@os.path.dirname(mvl_whereami(d))}/../tools'
include conf/toolchain/base/${MVL_ARCH_TOOLCHAIN}.conf
EXTERNAL_TOOLCHAIN ?= "${MVL_SDK_PREFIX}"
TOOLCHAIN_PATH = "${EXTERNAL_TOOLCHAIN}/bin/${TOOLCHAIN_DIR}/"
TOOLCHAIN_PATH_ADD = "${TOOLCHAIN_PATH}:"
PATH =. "${TOOLCHAIN_PATH_ADD}"
export OBJCOPY_class-target ="${TOOLCHAIN_PATH}/${HOST_PREFIX}objcopy"
export OBJDUMP_class-target ="${TOOLCHAIN_PATH}/${HOST_PREFIX}objdump"
export STRIP_class-target ="${TOOLCHAIN_PATH}/${HOST_PREFIX}strip"

EXTERNAL_GLIBC ?= "1"

COMPATIBLE_HOST_pn-glibc = "${@base_conditional('EXTERNAL_GLIBC', '1', '${SDK_SYS}' , '(.*)', d)}"
MV_GLIBC="${@base_conditional('EXTERNAL_GLIBC', '1', 'external-mvl-toolchain' , 'glibc', d)}"
#MV_KERNEL_HEADER="${@base_conditional('EXTERNAL_GLIBC', '1', 'external-mvl-toolchain', 'linux-libc-headers' , d)}"
MV_KERNEL_HEADER="external-mvl-toolchain"
PREFERRED_VERSION_glibc ?= "${@base_conditional('EXTERNAL_GLIBC', '1', '', '2.21' , d)}"

PREFERRED_PROVIDER_virtual/${TARGET_PREFIX}gcc = "external-mvl-toolchain"
PREFERRED_PROVIDER_virtual/${TARGET_PREFIX}gcc-initial = "external-mvl-toolchain"
PREFERRED_PROVIDER_virtual/${TARGET_PREFIX}gcc-intermediate = "external-mvl-toolchain"
PREFERRED_PROVIDER_virtual/${TARGET_PREFIX}g++ = "external-mvl-toolchain"
PREFERRED_PROVIDER_virtual/${TARGET_PREFIX}binutils = "external-mvl-toolchain"
PREFERRED_PROVIDER_virtual/${TARGET_PREFIX}compilerlibs = "external-mvl-toolchain"
PREFERRED_PROVIDER_libgcc = "external-mvl-toolchain"
PREFERRED_PROVIDER_virtual/linux-libc-headers = "${MV_KERNEL_HEADER}"
PREFERRED_PROVIDER_binutils-cross = "external-mvl-toolchain"
PREFERRED_PROVIDER_gcc-cross = "external-mvl-toolchain"
PREFERRED_PROVIDER_gdb-cross = "external-mvl-toolchain"
PREFERRED_PROVIDER_libc-mtrace = "external-mvl-toolchain"
PREFERRED_PROVIDER_virtual/${TARGET_PREFIX}libc-initial= 'external-mvl-toolchain'
PREFERRED_PROVIDER_virtual/libiconv-nativesdk = 'external-mvl-toolchain'

PREFERRED_PROVIDER_virtual/libiconv_mvista-cgx = "${MV_GLIBC}"
PREFERRED_PROVIDER_virtual/libintl_mvista-cgx = "gettext"
PREFERRED_PROVIDER_linux-libc-headers = "${MV_KERNEL_HEADER}"
PREFERRED_PROVIDER_linux-libc-headers-dev = "${MV_KERNEL_HEADER}"
PREFERRED_PROVIDER_virtual/libc = "${MV_GLIBC}"
PREFERRED_PROVIDER_glibc = "${MV_GLIBC}"
PREFERRED_PROVIDER_glibc-thread-db = "${MV_GLIBC}"
PREFERRED_PROVIDER_linux-libc-headers = "${MV_KERNEL_HEADER}"
PREFERRED_PROVIDER_virtual/libc-nativesdk = "${MV_GLIBC}"
PREFERRED_PROVIDER_virtual/${TARGET_PREFIX}libc-for-gcc = "${MV_GLIBC}"
#FIX ME: this needs to be cleaned up. It should be mostly uneeded if --sysroot works correctly

TOOLCHAIN_OPTIONS=" --sysroot=${STAGING_DIR_TARGET} "
BBMASK ?= "(catchemptybbmask)"
BBMASK .= "|(meta/external-csl-toolchain)|(meta/external-sourcery-toolchain)"
#FIX ME
MV_TAR_RELEASE ?= "${@mvl_toolchain_tar_version(d)}"
MV_TAR_RELEASE="150303"
def mvl_toolchain_tar_version(d):
    import glob
    toolchain=d.getVar("EXTERNAL_TOOLCHAIN", True)
    files=glob.glob("%s/sources/gcc*.tar.bz2" % (toolchain))
    files.sort(reverse=True) # Make sure to get the newest version
    gcc=os.path.basename(files[0])
    return gcc.split(".")[-3]

def mvl_whereami(d):
    import bb.process
    import subprocess
    topdir = d.getVar('TOPDIR', True)
    try:
       path=bb.process.run(["which","bitbake"], cwd=topdir, stderr=subprocess.PIPE)[0]
    except:
       return  ""
    return path
# Translate to CodeSourcery's names for their optimized files in the toolchain
def csl_target_core(d):
    coredata = {
        'armv7a-vfp-neon': 'armv7-a-neon',
        'i586': 'sgxx-glibc',
        'i686': 'sgxx-glibc',
        'mips': 'mips32',
        'mipsel': 'el',
        'powerpc-nf': 'nof',
        'ppce500': 'te500v1',
        'ppce500mc': 'te500mc',
        'ppce500v2': 'te500v2',
        'ppce600': 'te600'
    }
    return coredata.get(d.getVar('TUNE_PKGARCH', True), '')

CSL_TARGET_CORE = "${@csl_target_core(d)}"

# Unfortunately, the CSL ia32 toolchain has non-prefixed binaries in its
# bindir (e.g. gcc, ld). To avoid this messing up our build, we avoid adding
# this bindir to our PATH, and instead add symlinks to the prefixed binaries
# to our staging toolchain bindir.

python toolchain_metadata_setup () {
    if not isinstance(e, bb.event.ConfigParsed):
        return

    d = e.data

    if d.getVar('TUNE_PKGARCH', True) in ('i586', 'i686'):
        d.setVar('TOOLCHAIN_PATH_ADD', '')
}
addhandler toolchain_metadata_setup

python toolchain_setup () {
    if not isinstance(e, bb.event.BuildStarted):
        return

    d = e.data

    if d.getVar('TUNE_PKGARCH', True) in ('i586', 'i686'):
        populate_toolchain_links(d)
}
addhandler toolchain_setup

def populate_toolchain_links(d):
    import errno
    import os
    from glob import glob

    d = d.createCopy()
    d.finalize()

    pattern = d.expand('${EXTERNAL_TOOLCHAIN}/bin/${TARGET_PREFIX}*')
    files = glob(pattern)

    bindir = d.getVar('STAGING_BINDIR_TOOLCHAIN', True)
    bb.mkdirhier(bindir)
    for f in files:
        base = os.path.basename(f)
        newpath = os.path.join(bindir, base)
        try:
            os.symlink(f, newpath)
        except OSError as exc:
            if exc.errno == errno.EEXIST:
                break
            bb.fatal("Unable to populate toolchain binary symlink for %s: %s" % (newpath, exc))

require conf/distro/include/mvl-versions.inc
```

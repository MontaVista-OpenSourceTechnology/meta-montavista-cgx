## conf/machine/qemuarm64.conf
```bitbake
#@TYPE: Machine
#@NAME: generic armv8 machine
#@DESCRIPTION: Machine configuration for running a generic armv8

require conf/machine/include/qemu.inc
require conf/machine/include/arm/arch-armv8.inc
require conf/toolchain/arm64-glibc-linux.conf
MVL_ARCH_TOOLCHAIN='arm64-glibc-linux'
MACHINE_FEATURES = ""

KERNEL_IMAGETYPE = "Image"

SERIAL_CONSOLE = "38400 ttyAMA0"
```

## conf/machine/qemumips64.conf
```bitbake
#@TYPE: Machine
#@NAME: mti-malta64-be MIPS64
#@DESCRIPTION: mti-malta64-be

require conf/machine/include/qemu.inc
require conf/machine/include/tune-mips64.inc
require conf/machine/include/qemuboot-mips.inc
require conf/toolchain/mips64-glibc-linux.conf
KERNEL_IMAGETYPE = "vmlinux"

SERIAL_CONSOLE = "115200 ttyS0"

MACHINE_EXTRA_RRECOMMENDS = " kernel-modules"
```

## conf/machine/qemumips64nfp.conf
```bitbake
#@TYPE: Machine
#@NAME: mti_malta32_be MIPS
#@DESCRIPTION: mti_malta32_be

require conf/machine/include/qemu.inc
require conf/machine/include/tune-mips32r2.inc

require conf/toolchain/mips64nfp-glibc-linux.conf
require conf/machine/include/qemuboot-mips.inc
QB_SYSTEM_NAME = "qemu-system-mips64"
DEFAULTTUNE = "mips64_nf"
KERNEL_IMAGETYPE = "vmlinux"

SERIAL_CONSOLE = "115200 ttyS0"

MACHINE_EXTRA_RRECOMMENDS = " kernel-modules"
```

## conf/machine/qemux86-64.conf
```bitbake
#@TYPE: Machine
#@NAME: common_pc
#@DESCRIPTION: Machine configuration for running a common x86

PREFERRED_PROVIDER_virtual/xserver ?= "xserver-xorg"
PREFERRED_PROVIDER_virtual/libgl ?= "mesa"
PREFERRED_PROVIDER_virtual/libgles1 ?= "mesa"
PREFERRED_PROVIDER_virtual/libgles2 ?= "mesa"

require conf/machine/include/qemu.inc
require conf/machine/include/qemuboot-x86.inc
QB_OPT_APPEND = "-vga vmware -show-cursor -usb -usbdevice tablet -device virtio-rng-pci -smp 2"
KERNEL_IMAGETYPE = "bzImage"

SERIAL_CONSOLE = "115200 ttyS0"

XSERVER = "xserver-xorg \
           ${@bb.utils.contains('DISTRO_FEATURES', 'opengl', 'mesa-driver-swrast', '', d)} \
           xf86-input-vmmouse \
           xf86-input-keyboard \
           xf86-input-evdev \
           xf86-video-cirrus \
           xf86-video-fbdev \
           xf86-video-vmware"

MACHINE_FEATURES += "x86"

MACHINE_ESSENTIAL_EXTRA_RDEPENDS += "v86d"
DEFAULTTUNE ?= "core2-64"
require conf/machine/include/tune-core2.inc

require conf/toolchain/x86_64-glibc-linux.conf
```

## qemu-bsp/conf/layer.conf
```bitbake
BBPATH ?= ""
# We have a conf and classes directory, add to BBPATH
BBPATH := "${LAYERDIR}:${BBPATH}"

# We have an images and various recipe-* directories, add to BBFILES
BBFILES += "${LAYERDIR}/recipes/*/*.bb ${LAYERDIR}/recipes*/*/*.bb"
BBFILES += "${LAYERDIR}/recipes/*/*.bbappend ${LAYERDIR}/recipes*/*/*.bbappend"
	
BBFILE_COLLECTIONS += "cgx-montavista-qemu"
BBFILE_PATTERN_cgx-montavista-qemu := "^${LAYERDIR}/"
BBFILE_PRIORITY_cgx-montavista-qemu = "6"
LAYERSERIES_COMPAT_cgx-montavista-qemu = "dunfell"
```

## qemu-bsp/conf/machine/qemuarmhfp.conf
```bitbake
#@TYPE: Machine
#@NAME: arm_versatile_926ejs
#@DESCRIPTION: arm_versatile_926ejs

require conf/machine/include/qemu.inc
#Roll back to base

DEFAULTTUNE ?= "cortexa5thf-neon"
require conf/toolchain/armhfp-glibc-linux.conf
require conf/machine/include/tune-cortexa5.inc
KERNEL_DEVICETREE ?= "${S}/arch/arm/boot/dts/vexpress-v2p-ca15-tc1.dts"
KERNEL_IMAGETYPE = "zImage"


SERIAL_CONSOLE = "115200 ttyAMA0"
MVL_ARCH_TOOLCHAIN='armhfp-glibc-linux'
```

## qemu-bsp/conf/machine/qemumips.conf
```bitbake
#@TYPE: Machine
#@NAME: mti_malta32_be MIPS
#@DESCRIPTION: mti_malta32_be

PREFERRED_PROVIDER_virtual/kernel ?= "linux-mvista"
require conf/machine/include/qemu.inc
require conf/machine/include/tune-mips32r2.inc

KERNEL_IMAGETYPE = "vmlinux"

SERIAL_CONSOLE = "115200 ttyS0"

MACHINE_EXTRA_RRECOMMENDS = " kernel-modules"
```

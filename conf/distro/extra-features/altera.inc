## conf/distro/mvista-cgx.conf
```bitbake
include conf/layerinfo.inc
INHERIT_DISTRO="devshell sstate license remove-libtool" 
INHERIT += "mvl"

INHERIT += "image-groups"

TCLIBCAPPEND=""
PACKAGE_CLASSES = "package_rpm"
IMAGE_FSTYPES:append = " ext2.gz"
#IMAGE Defaults

VIRTUAL-RUNTIME_login_manager ?= "busybox"
VIRTUAL-RUNTIME_init_manager = "${@bb.utils.contains('USE_SYSTEMD', '1', 'systemd', 'sysvinit', d)}"
VIRTUAL-RUNTIME_initscripts = "${@bb.utils.contains('USE_SYSTEMD', '1', 'systemd-compat-units', 'initscripts', d)}"
VIRTUAL-RUNTIME_base-utils-syslog ?= "${@bb.utils.contains("BBFILE_COLLECTIONS", "openembedded-layer", " syslog-ng ", " sysklogd ", d)}"
VIRTUAL-RUNTIME_syslog ?= "${@bb.utils.contains("BBFILE_COLLECTIONS", "openembedded-layer", " syslog-ng ", " sysklogd ", d)}"
VIRTUAL-RUNTIME_keymaps ?= "keymaps"
VIRTUAL-RUNTIME_webserver ?= "apache2"

# Set Vanity values.
TARGET_VENDOR="-montavista"
SDK_VENDOR = "-montavistasdk"
SDK_NAME_PREFIX = "montavista"
SDK_VERSION = "${DISTRO_VERSION}"

# Emit shell script variables.
require conf/emit_shellscript.inc

# Export drlog.
require conf/drlog.inc

# Exportvars for devrocket.

INHERIT += "exportvars"
EXPORTVARSRUN="1"

# Generate mirror tarballs.

BB_GENERATE_MIRROR_TARBALLS ?= "1"

# Use Hashed stamps. 

BB_SIGNATURE_HANDLER = "OEBasicHash"

MVL_MIRROR="http://someplace.org/"
PREFERRED_PROVIDER_virtual/gettext ?= "gettext"
PREFERRED_PROVIDER_jpeg ?= "jpeg"
PREFERRED_PROVIDER_jpeg-native ?= "jpeg-native"
PREFERRED_PROVIDER_start-stop-daemon ?= "dpkg"

USE_SYSTEMD ?= "0"

DISTROOVERRIDES .= ":selinux"
MACHINEOVERRIDES .= ":${TUNE_ARCH}"
IMAGE_FEATURES += "mvl package-management"
#DISTRO_FEATURES:append =  "${@bb.utils.contains("BBFILE_COLLECTIONS", "selinux", " selinux ", "", d)}"
DISTRO_FEATURES:append =  "${@bb.utils.contains("BBFILE_COLLECTIONS", "virtualization-layer", " virtualization ", "", d)}"
DISTRO_FEATURES:append = " containers pam multiarch mvl opengl x11 ${@bb.utils.contains('USE_SYSTEMD', '1', 'systemd', 'sysvinit', d)} "
DISTRO_FEATURES:append = "mvista-base" 
DISTRO_FEATURES:append = "${@bb.utils.contains("CGX_PROFILES", "dataplane", " mvista-dataplane ", "", d)}"
DISTRO_FEATURES:append = "${@bb.utils.contains("CGX_PROFILES", "security", " mvista-security ", "", d)}"
DISTRO_FEATURES:append = "${@bb.utils.contains("CGX_PROFILES", "virtualization", " mvista-virtualization ", "", d)}"
DISTRO_FEATURES:append = "${@bb.utils.contains("CGX_PROFILES", "iot", " mvista-iot ", "", d)}"
DISTRO_FEATURES:append = "${@bb.utils.contains("CGX_PROFILES", "cgl", " mvista-cgl ", "", d)}"
DISTRO_FEATURES:append = "${@bb.utils.contains("CGX_PROFILES", "graphics", " mvista-graphics ", "", d)}"
DISTRO_FEATURES:append = " libc-locales libc-charsets libc-locale-code "
DISTRO_FEATURES:append = " ptest virtualization qatest security "

DISTRO_FEATURES:remove = "gobject-introspection-data"
DISTRO_FEATURES_BACKFILL_CONSIDERED = " ${@bb.utils.contains('USE_SYSTEMD', '1', 'sysvinit', '', d)} "
# Use extrausers to add extra user and group configurations.
INHERIT += "extrausers"

# Use skiplist
include conf/distro/include/mvl-skiplist.inc

include conf/distro/include/common-image.inc

# Don't die on dangling depends.
BB_DANGLINGAPPENDS_WARNONLY = "1"

#reduce to single lsb string.
NATIVELSBSTRING_mvista-cgx='universal'

# Do not error out if there is a kernel version mismatch.
KERNEL_VERSION_SANITY_SKIP="1"

#Turn off autoref for linux linaro this breaks parsing on no network.
AUTOREV:pn-linux-linaro = "8abe04ab20f5e2b7bc76b5e69860facc3a743760"
MERGEPERFILEDEPS_mvista-cgx = "0"

# Don't rename sources in a mirror
BB_NO_MODIFY_MIRROR = "1"
SUB_DISTRO ??= "Carrier Grade Express"
DISTRO_NAME="MontaVista ${SUB_DISTRO} Linux"
DISTRO_VERSION = "4.0"
DISTRO_CODENAME = "CGX4.0"

BB_BASEHASH_IGNORE_VARS:append = " MVLFETCH_OPTS MVLBASE STAGING_KERNEL_DIR LM_LICENSE_FILE ENABLE_CGE7_LM MVL_TOOLS_TOPLEVEL_PREFIX MSD_VERSION "
BB_BASEHASH_IGNORE_VARS:append = " PLUGIN_ID FEATURE_ID PLUGIN_NAME FEATURE_NAME VENDOR_NAME ADK_VERSION MSD_REVISION SSTATE_PKGARCH "
BB_BASEHASH_IGNORE_VARS:append = " HOST_FLAGS_FIXUPS SITEINFO_BITS TOPDIR KERNEL_CFG_LOCATION CSL_VER_NATIVE_GCC HOST_USER_UID"
BB_BASEHASH_IGNORE_VARS:append = " DRLOG_HANDLER"

export LM_LICENSE_FILE 
export ENABLE_CGE7_LM
SDKPATH = "/opt/${SDK_NAME_PREFIX}"

LICENSE_CREATE_PACKAGE ?= "1"

HOST_FLAGS_FIXUPS='${@bb.utils.contains("BUILD_ARCH", "i686", " -march=i686 ", "", d)}'
BUILD_CFLAGS:append = '${HOST_FLAGS_FIXUPS}'

PREFERRED_PROVIDER_virtual/kernel ?= "linux-mvista"
SRCPV:pn-linux-mvista ?= "${@bb.fetch2.get_srcrev(d)}"

PREFERRED_VERSION_linux-yocto ?= "5.10%"

PREFERRED_PROVIDER_virtual/libintl ?= "glibc"

#Perl is fixed locally waiting on upstream fix
SKIP_RECIPE[libnet-dns-perl]=""

#Add cgx-profile support
INHERIT += "cgx-profiles"

BUILDCFG_VARS:append = " CGX_PROFILES "

# export complete path of compiler
OECMAKE_C_COMPILER:class-target = "$(which $(echo ${CC} | while read COMPILER REST; do echo $COMPILER; done))"
OECMAKE_CXX_COMPILER:class-target = "$(which $(echo ${CXX} | while read COMPILER REST; do echo $COMPILER; done))"

# Include feature selection file, which includes kernel fragments
# files (.cfg) and dependent userspace applications based on available
# profiles
include conf/distro/extra-features/select-features.inc
#LINUXLIBCVERSION ?= "5.4%"

# Add content required to run toaster to buildtools tarball
TOOLCHAIN_HOST_TASK:append:pn-buildtools-tarball = " \
    nativesdk-python3-django \
    nativesdk-python3-pytz \
    nativesdk-python3-beautifulsoup4 \
"
# Preferr 64bit binaries by default
RPM_PREFER_ELF_ARCH ?= "2"

UNWINDERLIB="${@bb.utils.contains("BBFILE_COLLECTIONS", "clang-layer", "libcxx", "libunwind", d)}"
UNWINDERLIB_aarchilp32="libunwind"
UNWINDERLIB:armv6="libunwind"
UNWINDERLIB:armeb="libunwind"
UNWINDERLIB:riscv64=""
UNWINDERLIB_riscv=""
UNWINDERLIB_cortexa57-cortexa53="libunwind"
PREFERRED_PROVIDER_libunwind_mvista-cgx ?= "${UNWINDERLIB}"
MACHINE_FEATURES:remove = 'qemu-usermode'

DEFAULT_ENFORCING ?= "disabled"

ROOTFS_PKGMANAGE_BOOTSTRAP ?= ""
include conf/distro/include/layer-includes.inc

INHERIT += "serialize-recipe"

SERIALIZE_RECIPE:pn-icedtea7-native ?= "1"

# uninative
require conf/distro/include/yocto-uninative.inc
INHERIT += "uninative"
LSB_WARN="0"
LLVM_TARGETS_TO_BUILD_TARGET ?= ""
REPRODUCIBLE_TIMESTAMP_ROOTFS ?=""

require ${@bb.utils.contains('BBFILE_COLLECTIONS', 'meta-lmp-base', 'conf/distro/include/meta-lmp-base.inc', '', d)}

PTESTS_SLOW:append = " libunwind-ptest "
RM_WORK_EXCLUDE:append  = " qemu-xilinx-helper-native "

# For Build History
INHERIT += "buildhistory"
ERROR_QA_remove_pn-linux-mvista = "version-going-backwards"
```

## conf/layer.conf
```bitbake
BBPATH ?= ""
# We have a conf and classes directory, add to BBPATH
BBPATH := "${LAYERDIR}:${BBPATH}"

# We have an images and various recipe-* directories, add to BBFILES
BBFILES += "${LAYERDIR}/recipes/*/*.bb ${LAYERDIR}/recipes*/*/*.bb"
BBFILES += "${LAYERDIR}/recipes/*/*.bbappend ${LAYERDIR}/recipes*/*/*.bbappend"
	
BBFILE_COLLECTIONS += "cgx-montavista"
BBFILE_PATTERN_cgx-montavista := "^${LAYERDIR}/"
BBFILE_PRIORITY_cgx-montavista = "6"

# Custom licenses used by some packages in this layer
LICENSE_PATH += "${LAYERDIR}/files/custom-licenses"

LAYERSERIES_COMPAT_cgx-montavista = "thud"
LAYERDEPENDS_cgx-montavista = "core"

CGX_PROFILES += "base"
CGX_PROFILES_mvista-cgx += "base"

BBFILES_DYNAMIC += " \
   freescale-layer:${LAYERDIR}/dynamic-layers/freescale-layer/*/*/*.bbappend \
"

BBFILES_DYNAMIC += " \
   virtualization-layer:${LAYERDIR}/dynamic-layers/virtualization-layer/*/*/*.bbappend \
   virtualization-layer:${LAYERDIR}/dynamic-layers/virtualization-layer/*/*/*.bb \
   openstack-layer:${LAYERDIR}/dynamic-layers/openstack-layer/*/*/*.bbappend \
   core:${LAYERDIR}/dynamic-layers/core/*/*/*.bbappend \
   webserver:${LAYERDIR}/dynamic-layers/webserver/*/*/*.bbappend \
   openembedded-layer:${LAYERDIR}/dynamic-layers/openembedded-layer/*/*/*.bbappend \
   openembedded-layer:${LAYERDIR}/dynamic-layers/openembedded-layer/*/*/*.bb \
   networking-layer:${LAYERDIR}/dynamic-layers/networking-layer/*/*/*.bbappend \
   meta-python:${LAYERDIR}/dynamic-layers/meta-python/*/*/*.bbappend \
   gnome-layer:${LAYERDIR}/dynamic-layers/gnome-layer/*/*/*.bbappend \
   clang-layer:${LAYERDIR}/dynamic-layers/clang-layer/*/*/*.bbappend \
   rcar-gen3:${LAYERDIR}/dynamic-layers/rcar-gen3/*/*/*.bbappend \
"

# Set default lazy values to match poky. Layer versions selected by enabling mvista-base.
PREFERRED_VERSION_strace ??= "4.24"
PREFERRED_VERSION_u-boot-fw-utils ??= "2018.07"
PREFERRED_VERSION_u-boot ??= "2018.07"
PREFERRED_VERSION_u-boot-tools ??= "2018.07"

INHERIT += "sanity-meta-montavista-cgx"
```

## conf/machine/include/arm64/arch-armv8be.inc
```bitbake
DEFAULTTUNE ?= "aarch64be"

ARMPKGARCH ?= "aarch64be"

TUNEVALID[aarch64be] = "Enable instructions for aarch64"
TUNECONFLICTS[aarch64be] = ""
MACHINEOVERRIDES .= "${@bb.utils.contains("TUNE_FEATURES", "aarch64be", ":aarch64", "" ,d)}"

# Endian base configs
AVAILTUNES += "aarch64be aarch64be_32"
TUNE_FEATURES_tune-aarch64be ?= "aarch64be"
TUNE_FEATURES_tune-aarch64be_32 ?= "aarch64be n32"

TUNE_ARCH = "aarch64be${@bb.utils.contains("TUNE_FEATURES", "n32" , "_32", "", d)}"
TUNE_PKGARCH = "aarch64be${@bb.utils.contains("TUNE_FEATURES", "n32" , "_32", "", d)}"

PACKAGE_EXTRA_ARCHS_tune-aarch64be_32 = "aarch64be_32"

TUNEVALID[n32] = "AARCH64 ilp32 mode"
TUNECONFICTS[n32] = ""

TUNE_CCARGS += "${@bb.utils.contains("TUNE_FEATURES", "n32", " -mabi=ilp32 ", "", d)}"

AARCH_SYS="aarch64${TARGET_VENDOR}${@['-' + d.getVar('TARGET_OS', True), ''][d.getVar('TARGET_OS', True) == ('' or   'custom')]}"
HOST_SYS = "${@[d.getVar('AARCH_SYS'),d.expand('${HOST_ARCH}${HOST_VENDOR}-${HOST_OS}')][bb.data.inherits_class('native', d) or bb.data.inherits_class('nativesdk', d) or  bb.data.inherits_class('crosssdk', d)]}"
TARGET_SYS = "${@[[d.getVar('AARCH_SYS'),d.expand('${HOST_ARCH}${HOST_VENDOR}-${HOST_OS}')][bb.data.inherits_class('native', d) or bb.data.inherits_class('nativesdk', d)], d.expand('${SDK_ARCH}${SDK_VENDOR}-${SDK_OS}')][bb.data.inherits_class('crosssdk', d)]}"
TARGET_ARCH= "${TUNE_PKGARCH}"
```

## conf/machine/include/mips/arch-mips.inc
```bitbake
# MIPS Architecture definition
# 12 defined ABIs, all combinations of:
# *) Big/Little Endian
# *) Hardware/Software Floating Point
# *) o32, n32, n64 ABI

DEFAULTTUNE ?= "mips"

# Endianess
TUNEVALID[bigendian] = "Enable big-endian mode"
TUNE_CCARGS += "${@bb.utils.contains("TUNE_FEATURES", "bigendian", "-meb", "-mel", d)}"

# ABI flags
TUNEVALID[o32] = "MIPS o32 ABI"
TUNECONFLICTS[o32] = "n32 n64"
TUNE_CCARGS += "${@bb.utils.contains("TUNE_FEATURES", "o32", "-mabi=32", "", d)}"

TUNEVALID[n32] = "MIPS64 n32 ABI"
TUNECONFLICTS[n32] = "o32 n64"
TUNE_CCARGS += "${@bb.utils.contains("TUNE_FEATURES", "n32", "-mabi=n32", "", d)}"

TUNEVALID[n64] = "MIPS64 n64 ABI"
TUNECONFLICTS[n64] = "o32 n32"
TUNE_CCARGS += "${@bb.utils.contains("TUNE_FEATURES", "n64", "-mabi=64", "", d)}"

# Floating point
TUNEVALID[fpu-hard] = "Use hardware FPU"
TUNE_CCARGS += "${@bb.utils.contains("TUNE_FEATURES", "fpu-hard", "-mhard-float", "-msoft-float", d)}"
TARGET_FPU = "${@bb.utils.contains("TUNE_FEATURES", "fpu-hard", "", "soft", d)}"

# Package naming
MIPSPKGSFX_ENDIAN = "${@bb.utils.contains("TUNE_FEATURES", "bigendian", "", "el", d)}"
MIPSPKGSFX_BYTE = "${@bb.utils.contains("TUNE_FEATURES", "n64" , "64", "", d)}"
MIPSPKGSFX_BYTE .= "${@bb.utils.contains("TUNE_FEATURES", "n32" , "64", "", d)}"
MIPSPKGSFX_FPU = "${@bb.utils.contains("TUNE_FEATURES", "fpu-hard" , "", "_nf", d)}"
MIPSPKGSFX_ABI = "${@bb.utils.contains("TUNE_FEATURES", "n32", "_n32", "", d)}"

TUNE_ARCH = "mips${MIPSPKGSFX_BYTE}${MIPSPKGSFX_ENDIAN}"
TUNE_PKGARCH = "${MIPSPKGSFX_VARIANT_tune-${DEFAULTTUNE}}${MIPSPKGSFX_FPU}${MIPSPKGSFX_ABI}"

# Base tunes
AVAILTUNES += "mips mips64_n32 mips64 mipsel mips64el_n32 mips64el mips_nf mips64_nf_n32 mips64_nf mipsel_nf mips64el_nf_n32 mips64el_nf"
TUNE_FEATURES_tune-mips = "o32 bigendian fpu-hard"
BASE_LIB_tune-mips = "lib"
MIPSPKGSFX_VARIANT_tune-mips = "${TUNE_ARCH}"
PACKAGE_EXTRA_ARCHS_tune-mips = "mips"

TUNE_FEATURES_tune-mips64_n32 = "n32 bigendian fpu-hard"
BASE_LIB_tune-mips64_n32 = "lib32"
MIPSPKGSFX_VARIANT_tune-mips64_n32 = "${TUNE_ARCH}"
PACKAGE_EXTRA_ARCHS_tune-mips64_n32 = "mips64_n32"

TUNE_FEATURES_tune-mips64 = "n64 bigendian fpu-hard"
BASE_LIB_tune-mips64 = "lib64"
MIPSPKGSFX_VARIANT_tune-mips64 = "${TUNE_ARCH}"
PACKAGE_EXTRA_ARCHS_tune-mips64 = "mips64"

TUNE_FEATURES_tune-mipsel = "o32 fpu-hard"
BASE_LIB_tune-mipsel = "lib"
MIPSPKGSFX_VARIANT_tune-mipsel = "${TUNE_ARCH}"
PACKAGE_EXTRA_ARCHS_tune-mipsel = "mipsel"

TUNE_FEATURES_tune-mips64el_n32 = "n32 fpu-hard"
BASE_LIB_tune-mips64el_n32 = "lib32"
MIPSPKGSFX_VARIANT_tune-mips64el_n32 = "${TUNE_ARCH}"
PACKAGE_EXTRA_ARCHS_tune-mips64el_n32 = "mips64el_n32"

TUNE_FEATURES_tune-mips64el = "n64 fpu-hard"
BASE_LIB_tune-mips64el = "lib64"
MIPSPKGSFX_VARIANT_tune-mips64el = "${TUNE_ARCH}"
PACKAGE_EXTRA_ARCHS_tune-mips64el = "mips64el"

TUNE_FEATURES_tune-mips_nf = "o32 bigendian"
BASE_LIB_tune-mips_nf = "lib"
MIPSPKGSFX_VARIANT_tune-mips_nf = "${TUNE_ARCH}"
PACKAGE_EXTRA_ARCHS_tune-mips_nf = "mips_nf"

TUNE_FEATURES_tune-mips64_nf_n32 = "n32 bigendian"
BASE_LIB_tune-mips64_nf_n32 = "lib32"
MIPSPKGSFX_VARIANT_tune-mips64_nf_n32 = "${TUNE_ARCH}"
PACKAGE_EXTRA_ARCHS_tune-mips64_nf_n32 = "mips64_nf_n32"

TUNE_FEATURES_tune-mips64_nf = "n64 bigendian"
BASE_LIB_tune-mips64_nf = "lib64"
MIPSPKGSFX_VARIANT_tune-mips64_nf = "${TUNE_ARCH}"
PACKAGE_EXTRA_ARCHS_tune-mips64_nf = "mips64_nf"

TUNE_FEATURES_tune-mipsel_nf = "o32"
BASE_LIB_tune-mipsel_nf = "lib"
MIPSPKGSFX_VARIANT_tune-mipsel_nf = "${TUNE_ARCH}"
PACKAGE_EXTRA_ARCHS_tune-mipsel_nf = "mipsel_nf"

TUNE_FEATURES_tune-mips64el_nf_n32 = "n32"
BASE_LIB_tune-mips64el_nf_n32 = "lib32"
MIPSPKGSFX_VARIANT_tune-mips64el_nf_n32 = "${TUNE_ARCH}"
PACKAGE_EXTRA_ARCHS_tune-mips64el_nf_n32 = "mips64el_nf_n32"

TUNE_FEATURES_tune-mips64el_nf = "n64"
BASE_LIB_tune-mips64el_nf = "lib64"
MIPSPKGSFX_VARIANT_tune-mips64el_nf = "${TUNE_ARCH}"
PACKAGE_EXTRA_ARCHS_tune-mips64el_nf = "mips64el_nf"
```

## conf/machine/include/tune-cortexa15eb.inc
```bitbake
include conf/machine/include/tune-cortexa15.inc

AVAILTUNES += "cortexa15hfb cortexa15thfb"

ARMPKGARCH:tune-cortexa15hfb = "cortexa15"
ARMPKGARCH:tune-cortexa15thfb = "cortexa15"
TUNE_FEATURES:tune-cortexa15hfb ?= "${TUNE_FEATURES:tune-armv7ahf} cortexa15 bigendian"
TUNE_FEATURES:tune-cortexa15thfb ?= "${TUNE_FEATURES:tune-armv7athf} cortexa15 bigendian"
PACKAGE_EXTRA_ARCHS:tune-cortexa15hfb = "${PACKAGE_EXTRA_ARCHS:tune-armv7ahfb} cortexa15hfb-vfp"
PACKAGE_EXTRA_ARCHS:tune-cortexa15thfb = "${PACKAGE_EXTRA_ARCHS:tune-armv7athfb} cortexa15hfb-vfp cortexa15t2hfb-vfp"
```

## conf/machine/qemuarm.conf
```bitbake
#@TYPE: Machine
#@NAME: arm_versatile_926ejs
#@DESCRIPTION: arm_versatile_926ejs

require conf/machine/include/qemu.inc
#Roll back to base
require conf/machine/include/tune-cortexa7.inc

require conf/toolchain/arm-glibc-linux.conf
KERNEL_DEVICETREE ?= "vexpress-v2p-ca15-tc1.dtb"
KERNEL_IMAGETYPE = "zImage"

SERIAL_CONSOLE = "115200 ttyAMA0"
MVL_ARCH_TOOLCHAIN='arm-glibc-linux'
QB_SYSTEM_NAME = "qemu-system-arm"
QB_MACHINE = "-cpu cortex-a15 -M vexpress-a15 "
QB_KERNEL_CMDLINE_APPEND = "console=tty console=ttyAMA0,115200"
QB_DTB = "zImage-vexpress-v2p-ca15-tc1.dtb"
QB_TAP_OPT = "-net nic,vlan=0,macaddr=@MAC@ -net tap,vlan=0,ifname=@TAP@,script=no,downscript=no"
QB_ROOTFS_OPT = "-drive id=disk0,file=@ROOTFS@,if=none,format=raw -device virtio-blk-device,drive=disk0"
```

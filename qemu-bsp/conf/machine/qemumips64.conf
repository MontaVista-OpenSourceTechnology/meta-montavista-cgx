## qemu-bsp/conf/machine/qemumips64.conf
```bitbake
#@TYPE: Machine
#@NAME: mti-malta64-be MIPS64
#@DESCRIPTION: mti-malta64-be

PREFERRED_PROVIDER_virtual/kernel ?= "linux-mvista"
require conf/machine/include/qemu.inc
require conf/machine/include/tune-mips64.inc
require conf/machine/include/qemuboot-mips.inc
include conf/toolchain/mips64-glibc-linux.conf
KERNEL_IMAGETYPE = "vmlinux"

SERIAL_CONSOLE = "115200 ttyS0"

MACHINE_EXTRA_RRECOMMENDS = " kernel-modules"
```
